;------------------------------------------------------------------------------
;
; CAN rates
;
; Copyright (c) 2016 Darron Broad
;
;------------------------------------------------------------------------------
;
; This file is part of the Can-Can CAN bus interface project.
;
; Can-Can is licensed under the CC BY-NC-SA 4.0.
;
; See file /LICENSE for details.
; 
;------------------------------------------------------------------------------

                LIST
                RADIX   DEC

;------------------------------------------------------------------------------

#IFNDEF CANRATE
    ERROR       "CAN Bus rate not defined"
#ENDIF

#IF CLOCK != 16000000
    #IF CLOCK != 40000000
        #IF CLOCK != 48000000
            #IF CLOCK != 60000000
                #IF CLOCK != 64000000
                    ERROR   "CAN Bus rate not calculated"
               #ENDIF
	    #ENDIF
	#ENDIF
    #ENDIF
#ENDIF

CANRATE_ROM
; RATE, BRGCON1, BRGCON2, BRGCON3
;
#IF CLOCK == 16000000
    DB 0x00, 0x31, 0xBC, 0x01 ; 10
    DB 0x01, 0x18, 0xBC, 0x01 ; 20
    DB 0x02, 0x09, 0xBC, 0x01 ; 50
    DB 0x03, 0x04, 0xBC, 0x01 ; 100
    DB 0x04, 0x03, 0xBC, 0x01 ; 125
    DB 0x05, 0x01, 0xBC, 0x01 ; 250
    DB 0x06, 0x00, 0xBC, 0x01 ; 500
    DB 0x07, 0x00, 0x86, 0x00 ; 800
    DB 0x08, 0x00, 0x84, 0x00 ; 1000
#ENDIF

#IF CLOCK == 40000000
    DB 0x80, 0x31, 0xBC, 0x02 ; 10   - illegal
    DB 0x01, 0x31, 0xBF, 0x02 ; 20
    DB 0x02, 0x18, 0xBC, 0x01 ; 50
    DB 0x03, 0x18, 0x84, 0x00 ; 100
    DB 0x04, 0x09, 0xBC, 0x01 ; 125
    DB 0x05, 0x04, 0xBC, 0x01 ; 250
    DB 0x06, 0x04, 0x84, 0x00 ; 500
    DB 0x07, 0x00, 0xbf, 0x07 ; 800
    DB 0x08, 0x00, 0xbf, 0x02 ; 1000
#ENDIF

#IF CLOCK == 48000000
    DB 0x80, 0x3B, 0xBF, 0x02 ; 10   - illegal
    DB 0x01, 0x3B, 0xBF, 0x02 ; 20
    DB 0x02, 0x1D, 0xBC, 0x01 ; 50
    DB 0x03, 0x0E, 0xBC, 0x01 ; 100
    DB 0x04, 0x0B, 0xBC, 0x01 ; 125
    DB 0x05, 0x05, 0xBC, 0x01 ; 250
    DB 0x06, 0x02, 0xBC, 0x01 ; 500
    DB 0x07, 0x01, 0xBB, 0x01 ; 800
    DB 0x08, 0x02, 0x84, 0x00 ; 1000
#ENDIF

#IF CLOCK == 60000000
    DB 0x80, 0x3B, 0xBF, 0x07 ; 10   - illegal
    DB 0x01, 0x3B, 0xBF, 0x07 ; 20
    DB 0x02, 0x27, 0xBB, 0x01 ; 50
    DB 0x03, 0x13, 0xBB, 0x01 ; 100
    DB 0x04, 0x0E, 0xBC, 0x01 ; 125
    DB 0x05, 0x0E, 0x84, 0x00 ; 250
    DB 0x06, 0x03, 0xBB, 0x01 ; 500
    DB 0xF7, 0x01, 0xBB, 0x01 ; 800  - illegal
    DB 0x08, 0x01, 0xBB, 0x01 ; 1000
#ENDIF

#IF CLOCK == 64000000
    DB 0x80, 0x3F, 0xBF, 0x07 ; 10   - illegal
    DB 0x01, 0x3F, 0xBF, 0x07 ; 20
    DB 0x02, 0x27, 0xBC, 0x01 ; 50
    DB 0x03, 0x13, 0xBC, 0x01 ; 100
    DB 0x04, 0x0F, 0xBC, 0x01 ; 125
    DB 0x05, 0x07, 0xBC, 0x01 ; 250
    DB 0x06, 0x03, 0xBC, 0x01 ; 500
    DB 0x07, 0x04, 0x84, 0x00 ; 800
    DB 0x08, 0x01, 0xBC, 0x01 ; 1000
#ENDIF

#DEFINE CANRATE_ROM_DEFAULT (CANRATE_ROM + 5*4)	; S5 -> 250kBaud

;------------------------------------------------------------------------------
;
; vim: shiftwidth=4 tabstop=4 softtabstop=4 expandtab
;
