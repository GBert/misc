;------------------------------------------------------------------------------
;
; My GFP I2C LCD
;
; Copyright (c) 2018 Gerhard Bertelsmann
;
;------------------------------------------------------------------------------

		LIST
		RADIX   DEC

		CBLOCK	0x0222
		I2C_LCD_DATA	: 1
		I2C_LCD_CTYPE	: 1
		I2C_LCD_DTEMP	: 1
		ENDC

#DEFINE LCD_ADDRESS		0x27 << 1

#DEFINE	LCD_WAIT_DELAY		2
#DEFINE	LCD_BL			0x08
#DEFINE	LCD_EN			0x04
#DEFINE LCD_RW			0x02
#DEFINE LCD_RS			0x01
#DEFINE LCD_INIT_BYTE		0x30
#DEFINE LCD_BUS_WIDTH_4Bit	0x20
#DEFINE LCD_BUS_WIDTH_8Bit	0x30
#DEFINE LCD_CLEAR		0x01
#DEFINE LCD_HOME		0x02
#DEFINE LCD_ON			0x0C
#DEFINE LCD_OFF			0x08
#DEFINE LCD_LINE1		0x80
#DEFINE LCD_LINE2		0xC0
#DEFINE LCD_LINE3		0x94
#DEFINE LCD_LINE4		0xD4
#DEFINE LCD_CURSOR_OFF		0x0C
#DEFINE LCD_UNDERLINE_ON	0x0E
#DEFINE LCD_BLINK_CURSOR_ON	0x0F
#DEFINE LCD_MOVE_CURSOR_LEFT	0x10
#DEFINE LCD_MOVE_CURSOR_RIGHT	0x14
#DEFINE LCD_SHIFT_LEFT		0x18
#DEFINE LCD_SHIFT_RIGHT		0x1E
#DEFINE LCD_DISPLAY_ON_CURSOR_OFF 0x0c
#DEFINE LCD_DISPLAY_OFF_CURSOR_OFF_BLINK_OFF 0x08
#DEFINE LCD_4BITS_2LINES_5x8FONT 0x28
#DEFINE LCD_INCREMENT_NO_SHIFT	0x06


;------------------------------------------------------------------------------
; PCF8574 I2C 
;------------------------------------------------------------------------------

I2C_PCF8574_WRITE
		CALL	I2C_START
		BANKSEL	I2C_ADDR
		MOVF	I2C_ADDR,W
		MOVWF	I2C_BUF
		CALL	I2C_WRITE
		BTFSS	W,1
		BRA	I2C_PCF8574_WNEXT1
		BANKSEL	SSP1BUF
		MOVF	SSP1BUF,W		; dummy read
		BCF	SSP1CON1,WCOL
		
I2C_PCF8574_WNEXT1
		MOVF	I2C_DATA,W
		MOVWF	I2C_BUF
		CALL	I2C_WRITE
		; CALL	I2C_STOP	; TODO
		RETURN

I2C_PUT_CMD
		BANKSEL	I2C_LCD_DATA
		SWAPF	I2C_LCD_DATA,W
		ANDLW	0x0F
		IORLW	LCD_BL
		MOVWF	I2C_DATA
		CALL	I2C_PCF8574_WRITE
		BANKSEL	I2C_LCD_DATA
		MOVF	I2C_LCD_DATA,W
		ANDLW	0x0F
		IORLW	LCD_EN
		MOVWF	I2C_DATA
		CALL	I2C_PCF8574_WRITE
		BANKSEL	I2C_LCD_DATA
		MOVF	I2C_LCD_DATA,W
		ANDLW	~LCD_EN
		MOVWF	I2C_DATA
		CALL	I2C_PCF8574_WRITE
		; TODO
		RETURN

I2C_TEST	
		BANKSEL I2C_LCD_DATA
		MOVLW	LCD_ADDRESS
		MOVWF	I2C_ADDR
		MOVLW	0x0C
		MOVWF	I2C_DATA
		CALL	I2C_PCF8574_WRITE
		RETURN
		
