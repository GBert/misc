## rs485bpi/src/Kconfig
```kconfig
config RS485_BPI
    tristate "S88 GPIO"
    depends on GENERIC_GPIO
    select RS485_BPI
    help
      BPi RS485 Support
```

## s88-gpio/src/Kconfig
```kconfig
config BIT_BANG_GPIO
    tristate "S88 GPIO"
    depends on GENERIC_GPIO
    select S88_GPIO
    help
      Railroad S88 GPIO
```

## susi-gpio/src/Kconfig
```kconfig
config SUSI_GPIO
    tristate "SUSI GPIO"
    depends on GENERIC_GPIO
    select SUSI_GPIO
    help
      SUSI GPIO driver
```

## xpndev/src/Kconfig
```kconfig
config XPNDEV
    tristate ""
    depends on GENERIC_GPIO
    select XPNDEV
    help
      XpressNet Device Driver
```
